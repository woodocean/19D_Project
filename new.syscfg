/**
 * @cliArgs --device "F2837xD" --part "F2837xD_100PTP" --package "F2837xD_100PTP" --context "CPU1" --product "C2000WARE@5.05.00.00"
 * @versions {"tool":"1.24.0+4110"}
 */

/**
 * Import the modules used in this configuration.
 */
const adc  = scripting.addModule("/driverlib/adc.js", {}, false);
const adc1 = adc.addInstance();
const adc2 = adc.addInstance();

/**
 * Write custom configuration values to the imported modules.
 */
adc1.$name              = "myADC0";
adc1.adcBase            = "ADCB_BASE";
adc1.adcClockPrescaler  = "ADC_CLK_DIV_4_0";
adc1.enabledSOCs        = ["ADC_SOC_NUMBER0"];
adc1.soc0Trigger        = "ADC_TRIGGER_EPWM1_SOCA";
adc1.soc0SampleWindow   = 15;
adc1.soc0Channel        = "ADC_CH_ADCIN2";
adc1.interruptPulseMode = "ADC_PULSE_END_OF_CONV";
adc1.useInterrupts      = false;

adc2.$name                          = "myADC1";
adc2.adcClockPrescaler              = "ADC_CLK_DIV_4_0";
adc2.enabledSOCs                    = ["ADC_SOC_NUMBER0"];
adc2.soc0SampleWindow               = 15;
adc2.soc0Trigger                    = "ADC_TRIGGER_EPWM1_SOCA";
adc2.interruptPulseMode             = "ADC_PULSE_END_OF_CONV";
adc2.enabledInts                    = ["ADC_INT_NUMBER1"];
adc2.enableInterrupt1               = true;
adc2.enableInterrupt1ContinuousMode = true;
adc2.useInterrupts                  = false;
adc2.burstTrigger                   = "ADC_TRIGGER_EPWM1_SOCA";

const divider3 = system.clockTree["EPWMCLKDIV"];
scripting.suppress("ePWM TZFRC and TZCLR events will sometimes be missed when EPWMCLKDIV is divide by 2\\. Always program EPWMCLKDIV to divide by 1 if using TZFRC or TZCLR register\\. Please refer to the F2837xD Silicon Errata for more details\\.", divider3, "EPWMCLK");

const default_warning = scripting.addModule("/driverlib/default_warning.js", {}, false);
scripting.suppress("Add the \'Device Support\' module in order to use Clock Tree tool and generate device support files\\. This suggestion can be ignored if not using the Clock Tree tool\\.", default_warning);
