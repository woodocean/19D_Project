/**
 * These arguments were used when this file was generated. They will be automatically applied on subsequent loads
 * via the GUI or CLI. Run CLI with '--help' for additional information on how to override these arguments.
 * @cliArgs --device "F2837xD" --package "F2837xD_100PTP" --part "F2837xD_100PTP" --product "C2000WARE@3.01.00.00"
 * @versions {"tool":"1.14.0+2667"}
 */

/**
 * Import the modules used in this configuration.
 */
const adc  = scripting.addModule("/driverlib/adc.js", {}, false);
const adc1 = adc.addInstance();
const adc2 = adc.addInstance();
const adc3 = adc.addInstance();

/**
 * Write custom configuration values to the imported modules.
 */
adc1.$name                    = "myADC0";
adc1.enabledSOCs              = ["ADC_SOC_NUMBER0"];
adc1.soc0Trigger              = "ADC_TRIGGER_EPWM1_SOCA";
adc1.soc0SampleWindow         = 15;
adc1.interruptPulseMode       = "ADC_PULSE_END_OF_CONV";
adc1.enabledInts              = ["ADC_INT_NUMBER1"];
adc1.enableInterrupt1         = true;
adc1.registerInterrupts       = ["1"];
adc1.adcInt1.enableInterrupt  = true;
adc1.adcInt1.interruptHandler = "ADC_ISR";

adc2.$name              = "myADC1";
adc2.adcBase            = "ADCB_BASE";
adc2.enabledSOCs        = ["ADC_SOC_NUMBER0"];
adc2.soc0Channel        = "ADC_CH_ADCIN2";
adc2.soc0Trigger        = "ADC_TRIGGER_EPWM1_SOCA";
adc2.soc0SampleWindow   = 15;
adc2.interruptPulseMode = "ADC_PULSE_END_OF_CONV";

adc3.$name              = "myADC2";
adc3.adcBase            = "ADCC_BASE";
adc3.soc0Trigger        = "ADC_TRIGGER_EPWM1_SOCA";
adc3.soc0SampleWindow   = 15;
adc3.interruptPulseMode = "ADC_PULSE_END_OF_CONV";
adc3.enabledSOCs        = ["ADC_SOC_NUMBER0","ADC_SOC_NUMBER1"];
adc3.soc1Channel        = "ADC_CH_ADCIN3";
adc3.soc0Channel        = "ADC_CH_ADCIN2";
adc3.soc1Trigger        = "ADC_TRIGGER_EPWM1_SOCA";
adc3.soc1SampleWindow   = 15;
scripting.suppress("SOC1 Channel selected has no device pin found\\.", adc3, "soc1Channel");
scripting.suppress("SOC0 Channel selected has no device pin found\\.", adc3, "soc0Channel");
